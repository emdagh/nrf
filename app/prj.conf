## CMakeLists.txt
```
cmake_minimum_required(VERSION 3.20.0)
find_package(Zephyr REQUIRED HINTS $ENV{ZEPHYR_BASE})

project(app)

set(CMAKE_BUILD_NAME "${CMAKE_SYSTEM_NAME}-${CMAKE_SYSTEM_PROCESSOR}")

set(CMAKE_RUNTIME_OUTPUT_DIRECTORY "${CMAKE_BINARY_DIR}/bin/${CMAKE_BUILD_NAME}/${CMAKE_BUILD_TYPE}")
set(CMAKE_ARCHIVE_OUTPUT_DIRECTORY "${CMAKE_BINARY_DIR}/lib/${CMAKE_BUILD_NAME}/${CMAKE_BUILD_TYPE}")
set(CMAKE_LIBRARY_OUTPUT_DIRECTORY "${CMAKE_BINARY_DIR}/lib/${CMAKE_BUILD_NAME}/${CMAKE_BUILD_TYPE}")

set(CMAKE_CXX_FLAGS_RELWITHDEBINFO "-Og -ggdb")

set(CMAKE_BUILD_TYPE "RelWithDebInfo")

file(GLOB SRC src/*.cpp)

target_sources(${PROJECT_NAME} PRIVATE ${SRC})
```

## prj.conf
```kconfig
CONFIG_CPP=y
CONFIG_STD_CPP17=y
CONFIG_GPIO=y
CONFIG_DEBUG_OPTIMIZATIONS=y
```

## src/main.cpp
```c
#include <stdio.h>
#include <zephyr/drivers/gpio.h>
#include <zephyr/kernel.h>

#define NUM_LEDS 4

/* 1000 msec = 1 sec */
#define SLEEP_TIME_MS 1000
#define SLEEP_OFFSET_MS SLEEP_TIME_MS / NUM_LEDS

/* The devicetree node identifier for the "led0" alias. */
#define LED0_NODE DT_ALIAS(led0)
#define LED1_NODE DT_ALIAS(led1)
#define LED2_NODE DT_ALIAS(led2)
#define LED3_NODE DT_ALIAS(led3)

/*
 * A build error on this line means your board is unsupported.
 * See the sample documentation for information on how to fix this.
 */
static const struct gpio_dt_spec leds[NUM_LEDS] = {
  GPIO_DT_SPEC_GET(LED0_NODE, gpios),
  GPIO_DT_SPEC_GET(LED1_NODE, gpios),
  GPIO_DT_SPEC_GET(LED3_NODE, gpios),
  GPIO_DT_SPEC_GET(LED2_NODE, gpios)
};

//static const struct gpio_dt_spec led = GPIO_DT_SPEC_GET(LED1_NODE, gpios);

int main(void) {
  
  int ret;
  //bool led_state[NUM_LEDS] = { false };

  for(auto led: leds) {
    if (!gpio_is_ready_dt(&led)) {
      return 0;
    }
    ret = gpio_pin_configure_dt(&led, GPIO_OUTPUT_ACTIVE);
    if (ret < 0) {
      return 0;
    }
  }


  int i = 0;
  while (1) {
      ret = gpio_pin_set_dt(&leds[i], 0);
      ret = gpio_pin_set_dt(&leds[(i + 1) % NUM_LEDS], 1);
      k_msleep(SLEEP_OFFSET_MS);
      i = (i + 1) % NUM_LEDS;
  }
  return 0;
}
```
